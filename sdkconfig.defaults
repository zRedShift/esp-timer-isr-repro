## sdkconfig.defaults
```kconfig
# Rust often needs a bit of an extra main task stack size compared to C (the default is 3K)
CONFIG_ESP_MAIN_TASK_STACK_SIZE=64000

# Necessary, as we process Rust code on the system event loop, and sometimes run out of stack
CONFIG_ESP_SYSTEM_EVENT_TASK_STACK_SIZE=4096

# Enable the option to dispatch timer events directly from the timer ISR
# (the executor & async timer wrapper of `esp-idf-svc` are compatible with this dispatch method)
# This has lower latency as compared to dispatching via an intermediate task
# CONFIG_ESP_TIMER_SUPPORTS_ISR_DISPATCH_METHOD=y

# Enable posting to event loops directly from an ISR
# (the event loop wrapper of `esp-idf-svc` is compatible with this, including the async postbox wrapper)
CONFIG_ESP_EVENT_POST_FROM_ISR=y
```
